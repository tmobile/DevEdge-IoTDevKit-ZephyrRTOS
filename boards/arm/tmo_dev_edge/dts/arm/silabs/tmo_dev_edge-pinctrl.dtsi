/*
 * Copyright (c) 2023 T-Mobile USA, Inc.
 *
 * SPDX-License-Identifier: Apache-2.0
 */

#include <dt-bindings/pinctrl/gecko-pinctrl.h>

&pinctrl {
	/* configuration for uart0 device, default state */
	usart0_default: usart0_default {
		group1 {
			/* configure PA.1 as UART_RX and PA.0 as UART_TX */
			psels = <GECKO_PSEL(UART_TX, F, 4)>,
				<GECKO_PSEL(UART_RX, F, 5)>,
				<GECKO_LOC(UART, 28)>;
		};
	};
};
