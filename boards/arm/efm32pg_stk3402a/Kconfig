## dts/bindings/modem/murata,1sc.yaml
```yaml
# Copyright (c) 2022 T-Mobile USA, Inc.
# SPDX-License-Identifier: Apache-2.0

description: murata 1sc modem

compatible: "murata,1sc"

include: uart-device.yaml

properties:
    label:
      required: true

    mdm-wake-host-gpios:
      type: phandle-array
      required: true

    mdm-wake-mdm-gpios:
      type: phandle-array
      required: true

    mdm-reset-gpios:
      type: phandle-array
      required: true

    mdm-rst-done-gpios:
      type: phandle-array
      required: false

    mdm-rx-gpios:
      type: phandle-array
      required: true

    mdm-tx-gpios:
      type: phandle-array
      required: true

    mdm-rts-gpios:
      type: phandle-array
      required: true

    mdm-cts-gpios:
      type: phandle-array
      required: true
```

## dts/bindings/regulator/qorvo,act81461.yaml
```yaml
# Copyright (c) 2023 T-Mobile USA, Inc.
# SPDX-License-Identifier: Apache-2.0

description: |
  QORVO ACT81461 PMIC

  The PMIC has two buck converters and two LDOs. All need to be defined as
  child nodes, strictly following the BUCKBOOST, BUCK1, BUCK2, BOOST, LDO1,
  LDO2, and LDO3 node names.
  For example:

  pmic@25 {
    reg = <0x25>;
    ...
    BUCKBOOST {
      /* all properties for 400mA BUCKBOOST */
    };
    BUCK1 {
      /* all properties for 400mA DC-DC Stepdown BUCK1 */
    };
    LDO1 {
      /* all properties for LDO1 */
    };
    ...
  };

compatible: "qorvo,act81461"

include: [base.yaml, i2c-device.yaml, regulator.yaml]

properties:
  alert-gpios:
    type: phandle-array
    description: |
        Identifies any change in enabled system status state

  int-gpios:
    type: phandle-array
    description: |
        Identifies any change in enabled system status state

  pmic-override-reg-array:
    type: uint8-array
    description: This is the PMIC I2C register to write data to.

  pmic-override-reg-value-array:
    type: uint8-array
    description: This is the PMIC I2C register value to write.

  pmic-override-num:
    type: int
    description: This is number of PMIC override registers to do.

child-binding:
  include:
    - name: regulator.yaml
      property-allowlist:
        - regulator-always-on
        - regulator-boot-on
        - regulator-min-microvolt
        - regulator-max-microvolt
        - regulator-allowed-modes
        - regulator-initial-mode
```

## dts/bindings/sensor/ams,tsl2540.yaml
```yaml
# Copyright (c) 2022 T-Mobile USA, Inc.
# SPDX-License-Identifier: Apache-2.0

description: |
    TSL2540 series ambient light sensor.  See datasheet at
    https://ams.com/documents/20143/36005/TSL2540_DS000564_4-00.pdf/39728ac4-098c-9eca-b5ca-61d9c6f3a588

compatible: "ams,tsl2540"

include: i2c-device.yaml

properties:
    int-gpios:
      type: phandle-array
      required: false
      description: |
        Identifies the interrupt pin
```

## dts/bindings/sensor/semtech,sx9328.yaml
```yaml
# Copyright (c) 2019, Linaro Limited
# SPDX-License-Identifier: Apache-2.0

description: |
    Semtech SX9328/SX9324 Proximity Sensor

compatible: "semtech,sx9328"

include: [sensor-device.yaml, i2c-device.yaml]

properties:
  int-gpios:
    type: phandle-array
    description: |
      Connection for the NIRQ signal.  This signal is active-low when
      produced by the sensor.

  scan-period:
    type: int
    default: 22
    description: |
      Selects scan period for phases 0 & 1.
    enum:
      - 0 # Min (no idle time)
      - 1 # 2 ms
      - 2 # 4 ms
      - 3 # 6 ms
      - 4 # 8 ms
      - 5 # 10 ms
      - 6 # 14 ms
      - 7 # 18 ms
      - 8 # 22 ms
      - 9 # 26 ms
      - 10 # 30 ms
      - 11 # 34 ms
      - 12 # 38 ms
      - 13 # 42 ms
      - 14 # 46 ms
      - 15 # 50 ms
      - 16 # 56 ms
      - 17 # 62 ms
      - 18 # 68 ms
      - 19 # 74 ms
      - 20 # 80 ms
      - 21 # 90 ms
      - 22 # 100 ms (Typ.)
      - 23 # 200 ms
      - 24 # 300 ms
      - 25 # 400 ms
      - 26 # 600 ms
      - 27 # 800 ms
      - 28 # 1 s
      - 29 # 2 s
      - 30 # 3 s
      - 31 # 4 s

  scan-period-23:
    type: int
    default: 0
    description: |
      Selects scan period multiplier for phases 2 & 3.

      For value 0:
        Phase 2/3 Scan period = SCANPERIOD x1
      For value 1:
        Phase 2/3 Scan period = SCANPERIOD x4
      For value 2:
        Phase 2/3 Scan period = SCANPERIOD x8
      For value 3:
        Phase 2/3 Scan period = SCANPERIOD x16
    enum:
      - 0 # x1
      - 1 # x4
      - 2 # x8
      - 3 # x16

  doze-period:
    type: int
    default: 0
    description: |
      Selects scan period multiplier for doze mode.

      For value 0:
        Doze mode off
      For value 1:
        Doze mode scan period = SCANPERIOD x4
      For value 2:
        Doze mode scan period = SCANPERIOD x8
      For value 3:
        Doze mode scan period = SCANPERIOD x16
    enum:
      - 0 # 30ms
      - 1 # x4
      - 2 # x8
      - 3 # x16

  freq-01:
    type: int
    default: 8
    description: |
      Sampling frequency for phases 0 & 1.
    enum:
      - 0 # 250 kHz
      - 1 # 200 kHz
      - 2 # 166.67 kHz
      - 3 # 142.86 kHz
      - 4 # 125 kHz
      - 5 # 111.11 kHz
      - 6 # 100 kHz
      - 7 # 90.91 kHz
      - 8 # 83.33 kHz
      - 9 # 76.92 kHz
      - 10 # 71.43 kHz
      - 11 # 66.67 kHz
      - 12 # 62.50 kHz
      - 13 # 58.82 kHz
      - 14 # 55.56 kHz
      - 15 # 52.63 kHz
      - 16 # 50 kHz
      - 17 # 45.45 kHz
      - 18 # 41.67 kHz
      - 19 # 38.46 kHz
      - 20 # 35.71 kHz
      - 21 # 31.25 kHz
      - 22 # 27.78 kHz
      - 23 # 25 kHz
      - 24 # 20.83 kHz
      - 25 # 17.86 kHz
      - 26 # 13.89 kHz
      - 27 # 11.36 kHz
      - 28 # 8.33 kHz
      - 29 # 6.58 kHz
      - 30 # 5.43 kHz
      - 31 # 4.63 kHz

  freq-23:
    type: int
    default: 8
    description: |
      Sampling frequency for phases 2 & 3.
    enum:
      - 0 # 250 kHz
      - 1 # 200 kHz
      - 2 # 166.67 kHz
      - 3 # 142.86 kHz
      - 4 # 125 kHz
      - 5 # 111.11 kHz
      - 6 # 100 kHz
      - 7 # 90.91 kHz
      - 8 # 83.33 kHz
      - 9 # 76.92 kHz
      - 10 # 71.43 kHz
      - 11 # 66.67 kHz
      - 12 # 62.50 kHz
      - 13 # 58.82 kHz
      - 14 # 55.56 kHz
      - 15 # 52.63 kHz
      - 16 # 50 kHz
      - 17 # 45.45 kHz
      - 18 # 41.67 kHz
      - 19 # 38.46 kHz
      - 20 # 35.71 kHz
      - 21 # 31.25 kHz
      - 22 # 27.78 kHz
      - 23 # 25 kHz
      - 24 # 20.83 kHz
      - 25 # 17.86 kHz
      - 26 # 13.89 kHz
      - 27 # 11.36 kHz
      - 28 # 8.33 kHz
      - 29 # 6.58 kHz
      - 30 # 5.43 kHz
      - 31 # 4.63 kHz

  gain-01:
    type: int
    default: 1
    description: |
      Digital gain for phases 0 & 1.
    enum:
      - 1 # x1 (Off)
      - 2 # x2
      - 3 # x4
      - 4 # x8

  gain-23:
    type: int
    default: 1
    description: |
      Digital gain for phases 2 & 3.
    enum:
      - 1 # x1 (Off)
      - 2 # x2
      - 3 # x4
      - 4 # x8

  proximity-threshold-01:
    type: int
    default: 8
    description: |
      Proximity thresholds for phases 0 & 1.

  body-threshold-01:
    type: int
    default: 0
    description: |
      Body threshold for phases 0 & 1.
    enum:
      - 0 # Off
      - 1 # 2048
      - 2 # 4096
      - 3 # 6144
      - 4 # 8192
      - 5 # 10240
      - 6 # 12288
      - 7 # 14336
      - 8 # 16384
      - 9 # 18432
      - 10 # 20480
      - 11 # 22528
      - 12 # 24576
      - 13 # 26624
      - 14 # 28672
      - 15 # 30720

  table-high-threshold-01:
    type: int
    default: 0
    description: |
      High table threshold for phases 0 & 1.
    enum:
      - 0 # Off
      - 1 # 2048
      - 2 # 4096
      - 3 # 6144
      - 4 # 8192
      - 5 # 10240
      - 6 # 12288
      - 7 # 14336
      - 8 # 16384
      - 9 # 18432
      - 10 # 20480
      - 11 # 22528
      - 12 # 24576
      - 13 # 26624
      - 14 # 28672
      - 15 # 30720

  table-low-threshold-01:
    type: int
    default: 0
    description: |
      Low table threshold for phases 0 & 1.
    enum:
      - 0 # Off
      - 1 # 2048
      - 2 # 4096
      - 3 # 6144
      - 4 # 8192
      - 5 # 10240
      - 6 # 12288
      - 7 # 14336
      - 8 # 16384
      - 9 # 18432
      - 10 # 20480
      - 11 # 22528
      - 12 # 24576
      - 13 # 26624
      - 14 # 28672
      - 15 # 30720

  proximity-threshold-23:
    type: int
    default: 8
    description: |
      Proximity thresholds for phases 2 & 3.

  body-threshold-23:
    type: int
    default: 0
    description: |
      Body threshold for phases 2 & 3.
    enum:
      - 0 # Off
      - 1 # 2048
      - 2 # 4096
      - 3 # 6144
      - 4 # 8192
      - 5 # 10240
      - 6 # 12288
      - 7 # 14336
      - 8 # 16384
      - 9 # 18432
      - 10 # 20480
      - 11 # 22528
      - 12 # 24576
      - 13 # 26624
      - 14 # 28672
      - 15 # 30720

  table-high-threshold-23:
    type: int
    default: 0
    description: |
      High table threshold for phases 2 & 3.
    enum:
      - 0 # Off
      - 1 # 2048
      - 2 # 4096
      - 3 # 6144
      - 4 # 8192
      - 5 # 10240
      - 6 # 12288
      - 7 # 14336
      - 8 # 16384
      - 9 # 18432
      - 10 # 20480
      - 11 # 22528
      - 12 # 24576
      - 13 # 26624
      - 14 # 28672
      - 15 # 30720

  table-low-threshold-23:
    type: int
    default: 0
    description: |
      Low table threshold for phases 2 & 3.
    enum:
      - 0 # Off
      - 1 # 2048
      - 2 # 4096
      - 3 # 6144
      - 4 # 8192
      - 5 # 10240
      - 6 # 12288
      - 7 # 14336
      - 8 # 16384
      - 9 # 18432
      - 10 # 20480
      - 11 # 22528
      - 12 # 24576
      - 13 # 26624
      - 14 # 28672
      - 15 # 30720

  close-debounce:
    type: int
    default: 2
    description: |
      Close debouncer applied to all proximity measurements
    enum:
      - 0 # Off
      - 1 # 2 samples
      - 2 # 4 samples
      - 3 # 8 samples

  far-debounce:
    type: int
    default: 2
    description: |
      Close debouncer applied to all proximity measurements
    enum:
      - 0 # Off
      - 1 # 2 samples
      - 2 # 4 samples
      - 3 # 8 samples

child-binding:
  description: |
    Settings for each phase 0-3.

  properties:
    phase-num:
      type: int
      required: true
      description: |
        Phase number.
      enum:
        - 0
        - 1
        - 2
        - 3

    enabled:
      type: boolean
      description: |
        Deterimines whether a given phase is enabled on startup

    prx-sns:
      type: boolean
      description: |
        Deterimines whether a given phase is used for (generic) proximity sensing

    tbl-sns:
      type: boolean
      description: |
        Deterimines whether a given phase is used for table sensing

    bdy-sns:
      type: boolean
      description: |
        Deterimines whether a given phase is used for body sensing

    cs0-use:
      type: int
      default: 0
      description: |
        Phase usage of the cs0 pin
      enum:
        - 0 # "high-z"
        - 1 # "measured"
        - 2 # "shield"
        - 3 # "ground"

    cs1-use:
      type: int
      default: 0
      description: |
        Phase usage of the cs1 pin
      enum:
        - 0 # "high-z"
        - 1 # "measured"
        - 2 # "shield"
        - 3 # "ground"

    cs2-use:
      type: int
      default: 0
      description: |
        Phase usage of the cs2 pin
      enum:
        - 0 # "high-z"
        - 1 # "measured"
        - 2 # "shield"
        - 3 # "ground"
```

## dts/bindings/sensor/sony,cxd5605.yaml
```yaml
# Copyright (c) 2021 Kim Mansfield <kmansfie@yahoo.com>
# Copyright (c) 2022 T-Mobile USA, Inc.
# SPDX-License-Identifier: Apache-2.0

description: |
    cxd5605 Digital GNSS Sensor.  See more info at
    https://www.sony-semicon.com/en/products/lsi-ic/gps.html

compatible: "sony,cxd5605"

include: i2c-device.yaml

properties:
    alert-gpios:
      type: phandle-array
      required: true
      description: |
        Identifies the data ready signal, which is active-high when
        the sensor has data to be read.
    int-gpios:
      type: phandle-array
      required: true
      description: |
        Identifies the 1 pulse per second  signal, which is active-high when the one second
        interval has expired.
    pwr-gpios:
      type: phandle-array
      required: true
      description: |
        Controls the power to the GNSS chip.  High on this pin will turn on the GNSS chip
        low turns it off.
    rst-gpios:
      type: phandle-array
      required: true
      description: |
        Reset line to the GNSS chip.  High on this pin will reset the GNSS chip.
    boot-rec-gpios:
      type: phandle-array
      required: true
      description: |
        Sets the boot mode of the GNSS chip.
```

## dts/bindings/serial/silabs,gecko-leuart.yaml
```yaml
description: Gecko LEUART

compatible: "silabs,gecko-leuart"

include: uart-controller.yaml

properties:
    reg:
      required: true

    interrupts:
      required: true

    peripheral-id:
      type: int
      required: false
      description: peripheral ID

    # Note: Not all SoC series support setting individual pin location. If this
    # is a case all location-* properties need to have identical value.

    location-rx:
      type: array
      description: RX pin configuration defined as <location port pin>

    location-tx:
      type: array
      description: TX pin configuration defined as <location port pin>
```
