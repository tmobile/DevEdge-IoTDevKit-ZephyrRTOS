## boards/arm/efm32pg_stk3402a/Kconfig
```kconfig
# EFM32PG_STK3402A board

# Copyright (c) 2022, Silicon Labs
# Copyright (c) 2022 T-Mobile USA, Inc.
# SPDX-License-Identifier: Apache-2.0

if BOARD_EFM32PG_STK3402A

module = BOARD_EFM32PG
module-str = Board Control
source "subsys/logging/Kconfig.template.log_config"

endif # BOARD_EFM32PG_STK3402A
```

## boards/arm/efm32pg_stk3402a/dts/bindings/silabs,gecko-wake-up-triggers.yaml
```yaml
# Copyright (c) 2022, Antmicro
# Copyright (c) 2022 T-Mobile USA, Inc.
# SPDX-License-Identifier: Apache-2.0

description: GPIO Wake Up Trigger for EFM32PG

compatible: "silabs,gecko-wake-up-trigger"

include: base.yaml

properties:
  gpios:
    type: phandle-array
    required: true
    description: |
      GPIO used as wake up trigger from EM4 sleep
```

## boards/arm/tmo_dev_edge/Kconfig
```kconfig
# TMO_DEV_EDGE board

# Copyright (c) 2022, Silicon Labs
# Copyright (c) 2023 T-Mobile USA, Inc.
# SPDX-License-Identifier: Apache-2.0

if BOARD_TMO_DEV_EDGE

module = BOARD_TMO_EDGE
module-str = Board Control
source "subsys/logging/Kconfig.template.log_config"

endif # BOARD_TMO_DEV_EDGE
```

## boards/shields/x_nucleo_iks01a4/Kconfig.shield
```kconfig
# Copyright (c) 2023 Linaro Limited
# SPDX-License-Identifier: Apache-2.0

config SHIELD_X_NUCLEO_IKS01A4
	def_bool $(shields_list_contains,x_nucleo_iks01a4)
```

## drivers/adc/Kconfig.gecko
```kconfig
# Gecko ADC configuration options
#
# Copyright (c) 2022 T-Mobile USA, Inc.
# SPDX-License-Identifier: Apache-2.0

config ADC_GECKO_IADC
	bool "Gecko Incremental ADC driver"
	default y
	depends on DT_HAS_SILABS_GECKO_IADC_ENABLED
	select SOC_GECKO_IADC
	select ADC_CONFIGURABLE_INPUTS
	help
	  Enable the driver implementation for the Silabs GeckoEXX32 Incremental ADC

config ADC_GECKO
	bool "GECKO ADC driver"
	default y
	select SOC_GECKO_ADC
	help
	  Enable support for Pearl Gecko ADC driver series.

config SOC_GECKO_ADC
	bool
	default n
```

## drivers/counter/Kconfig.gecko
```kconfig
# Silicon Labs Gecko Counter driver config

# Copyright (c) 2019, Piotr Mienkowski
# Copyright (c) 2022 T-Mobile USA, Inc.
#
# SPDX-License-Identifier: Apache-2.0

config COUNTER_GECKO_RTCC
	bool "Silicon Labs Gecko Counter (RTCC) driver"
	default y
	depends on DT_HAS_SILABS_GECKO_RTCC_ENABLED && !TIME_GECKO_RTCC
	select SOC_GECKO_CMU
	select SOC_GECKO_RTCC
	help
	  Enable counter driver based on RTCC module with the RTCC_CTRL
	  CNTMODE field set to NORMAL mode running at a 30.5 microsecond rate
	  overflowing in 36.4 hours for Silicon Labs Gecko chips.

config TIME_GECKO_RTCC
	bool "Silicon Labs Gecko Time (RTCC) driver"
	depends on DT_HAS_SILABS_GECKO_RTCC_ENABLED && SOC_FAMILY_EXX32
	select SOC_GECKO_CMU
	select SOC_GECKO_RTCC
	select POLL
	help
	  Enable time driver based on RTCC module with the RTCC_CTRL
	  CNTMODE field set to CALENDAR mode running at 1 second rate
	  overflowing in 136 years for Silicon Labs Gecko chips.
	  This mode will also synchronize with the Posix time.
```

## drivers/fuel_gauge/act81461/Kconfig
```kconfig
# Copyright (c)	2023 T-Mobile USA, Inc.
# SPDX-License-Identifier: Apache-2.0

config ACT81461_ALPC
	bool "ACT81461 ALPC Charger Fuel Gauge"
	default y
	depends on DT_HAS_QORVO_ACT81461_ALPC_ENABLED
	select I2C
	help
	  Enable driver for reading charger and battery information from the Qorvo ACT81461 PMIC
```

## drivers/fuel_gauge/sbs_battery/Kconfig
```kconfig
# Copyright (c) 2022 T-Mobile USA, Inc.
# SPDX-License-Identifier: Apache-2.
 

config SBS_BATTERY_NEW_API
	bool "Smart Battery"
	default y
	depends on DT_HAS_SBS_SBS_BATTERY_ENABLED
	select ADC
	help
	  Enable battery driver.
```

## drivers/i2c/Kconfig.gecko
```kconfig
# Copyright (c) 2022 T-Mobile USA, Inc.
# SPDX-License-Identifier: Apache-2.0

config I2C_GECKO
	bool "Gecko I2C driver"
	depends on HAS_SILABS_GECKO
	select SOC_GECKO_I2C
	help
	  Enable the SiLabs Gecko I2C bus driver.

config I2C_GECKO_XFER_TIMEOUT
	int "Gecko I2C semaphore timeout in MS"
	default 100
	range 1 30000
	depends on I2C_GECKO
	help
	  Timeout for the transfer semaphore in the Gecko I2C Driver
```

## drivers/modem/Kconfig.murata-1sc
```kconfig
# Murata 1SC driver options

# Copyright (c) 2022 T-Moblie
# SPDX-License-Identifier: Apache-2.0

menuconfig MODEM_MURATA_1SC
		bool "Murata-1sc modem driver"
		select MODEM_CONTEXT
		select MODEM_CMD_HANDLER
		select MODEM_IFACE_UART
		select MODEM_SOCKET
		select NET_SOCKETS_OFFLOAD
		select BASE64
		imply GPIO
		help
		  Choose this setting to enable Murata 1SC modem
		  driver.

if MODEM_MURATA_1SC
config MODEM_MURATA_1SC_RX_STACK_SIZE
		int "Stack size for the MURATA_1SC modem driver RX thread"
		default 1028
		help
		  This stack is used by the MURATA_1SC RX thread.

config MODEM_MURATA_1SC_RX_WORKQ_STACK_SIZE
		int "Stack size for the MURATA_1SC modem driver work queue"
		default 2048
		help
		  This stack is used by the work queue to pass off net_pkt data
		  to the rest of the network stack, letting the rx thread continue
		  processing data.

config MODEM_MURATA_1SC_APN
		string "APN for establishing network connection"
		default ""
		help
		  This setting is used to set the APN name for the network connection
		  context. This value is specific to the network provider

config MODEM_MURATA_1SC_INIT_PRIORITY
		int "MURATA_1SC driver init priority"
		default 80
		help
		  MURATA_1SC device driver initialization priority.
		  Do not mess with it unless you know what you are doing.
		  Note that the priority needs to be lower than the net stack
		  so that it can start before the networking sub-system.

config MODEM_MURATA_1SC_SOCKET_COUNT
		int "MURATA_1SC Maximum concurrent sockets allowed"
		range 1 6
		default 4
		help
		  This value sets the maximum number of allowed concurrent sockets
		  for the 1sc modem.

config SNI_SLOT
		int "customer server's CA slot"
		default 8
		help
		  This is cert profile ID for customer server that requires SNI extension.

config MODEM_ON_DELAY
		int "wait period (in ms) before turn on modem"
		default 1000
		help
		  This value is for murata-1sc driver to wait before turn cfun=1

config MODEM_DEMO_LOW_POWERMODE
		bool "low-power mode (essentially disable the modem)"
		help
		  This is to keep modem inactive for minimal power usage.

endif  #MODEM_MURATA_1SC
```

## drivers/regulator/Kconfig.act81461
```kconfig
# Copyright (c)	2021, NXP
# Copyright (c)	2023 T-Mobile USA, Inc.
# SPDX -License-Identifier: Apache-2.0

DT_COMPAT_PMIC_REG := qorvo,act81461

config REGULATOR_ACT81461
	bool "PMIC Regulator Driver"
	depends on $(dt_compat_enabled,$(DT_COMPAT_PMIC_REG))
	default $(dt_compat_enabled,$(DT_COMPAT_PMIC_REG))
	select	I2C
	help
	  Enable the pmic regulator driver

if REGULATOR_ACT81461

config REGULATOR_ACT81461_COMMON_INIT_PRIORITY
	int "ACT81461 regulator driver parent init priority"
	default 55
	help
	  Init priority for the QORVO parent regulator	driver.
	  It must be greater than I2C init priority.

config REGULATOR_ACT81461_INIT_PRIORITY
	int "regulator driver parent init priority"
	default 56
	help
	  Init priority for the QORVO regulator child driver. It must be
	  greater than	parent REGULATOR_ACT81461_COMMON_INIT_PRIORITY.

config REGULATOR_ACT81461_VOLTAGE_LIMITS
	bool "Use voltage limits in voltage set functions"
	default y

if REGULATOR_ACT81461_VOLTAGE_LIMITS

config REGULATOR_ACT81461_BUCKBOOST_VSET_MIN
	int "Minimum allowable VSET value for the buck-boost converter (inclusive)"
	range 0 54
	default 1

config REGULATOR_ACT81461_BUCKBOOST_VSET_MAX
	int "Maximum allowable VSET value for the buck-boost converter (inclusive)"
	range 0 54
	default 6

config REGULATOR_ACT81461_BUCK1_VSET_MIN
	int "Minimum allowable VSET value for the buck1 buck converter (inclusive)"
	range 0 60
	default 24

config REGULATOR_ACT81461_BUCK1_VSET_MAX
	int "Maximum allowable VSET value for the buck1 buck converter (inclusive)"
	range 0 60
	default 27

config REGULATOR_ACT81461_BUCK2_VSET_MIN
	int "Minimum allowable VSET value for the buck2 buck converter (inclusive)"
	range 0 60
	default 24

config REGULATOR_ACT81461_BUCK2_VSET_MAX
	int "Maximum allowable VSET value for the buck2 buck converter (inclusive)"
	range 0 60
	default 27

config REGULATOR_ACT81461_BOOST_VSET_MIN
	int "Minimum allowable VSET value for the boost converter (inclusive)"
	range 0 63
	default 0

config REGULATOR_ACT81461_BOOST_VSET_MAX
	int "Maximum allowable VSET value for the boost converter (inclusive)"
	range 0 63
	default 2

config REGULATOR_ACT81461_LDO1_VSET_MIN
	int "Minimum allowable VSET value for LDO1 (inclusive)"
	range 0 60
	default 30

config REGULATOR_ACT81461_LDO1_VSET_MAX
	int "Maximum allowable VSET value for LDO1 (inclusive)"
	range 0 60
	default 39

config REGULATOR_ACT81461_LDO2_VSET_MIN
	int "Minimum allowable VSET value for LDO2 (inclusive)"
	range 0 60
	default 33

config REGULATOR_ACT81461_LDO2_VSET_MAX
	int "Maximum allowable VSET value for LDO2 (inclusive)"
	range 0 60
	default 39

config REGULATOR_ACT81461_LDO3_VSET_MIN
	int "Minimum allowable VSET value for LDO3 (inclusive)"
	range 0 60
	default 24

config REGULATOR_ACT81461_LDO3_VSET_MAX
	int "Maximum allowable VSET value for LDO3 (inclusive)"
	range 0 60
	default 26

endif # REGULATOR_ACT81461_VOLTAGE_LIMITS

endif # REGULATOR_ACT81461
```

## drivers/sensor/cxd5605/Kconfig
```kconfig
# CXD5605 GNSS/GPS configuration options

# Copyright (c) 2021 Kim Mansfield <kmansfie@yahoo.com>
# Copyright (c) 2022 T-Mobile USA, Inc.
# SPDX-Licnse-Identifiere: Apache-2.0
#

menuconfig CXD5605
	bool "CXD5605R GNSS/GPS"
	depends on I2C
	imply CXD5605_LIB
	help
		Enable I2C based driver for the CXD5605 based GNSS/GPS

if CXD5605

config CXD5605_ALERT_INTERRUPTS
	bool "Allow interrupts to service 1 pulse per second"
	help
		This will set up interrupts to service the 1 pulse per second and allow
		the application to get a callback one time per second.

config CXD5605_INIT_SUSPENDED
	bool "Allow the GNSS chip to come up in a suspended state"
	help
		This will initialize the CXD5605 into the sleep 2 state rather than 
		having it on.

config CXD5605_OWN_THREAD
	bool "Have the GNSS driver use its own thread"
	help
		If this option is selected, the CXD5605 driver will use its own thread,
		otherwise it will use the kernel work queue.

endif # CXD5605
```

## drivers/sensor/sx9328/Kconfig
```kconfig
# SX9328 SAR proximity sensor configuration options

# Copyright (c) 2023 T-Mobile USA, Inc.
# SPDX-License-Identifier: Apache-2.0

menuconfig SX9328
	bool "SX9328/SX9324 I2C SAR Proximity Chip"
	default y
	depends on DT_HAS_SEMTECH_SX9328_ENABLED
	select I2C
	help
	  Enable driver for SX9328 or SX9324 I2C-based SAR proximity sensor.

if SX9328

choice
	prompt "SX9328 trigger mode"
	default SX9328_TRIGGER_GLOBAL_THREAD

config SX9328_TRIGGER_NONE
	bool "No trigger"

config SX9328_TRIGGER_GLOBAL_THREAD
	depends on GPIO
	select SX9328_TRIGGER
	bool "Use global thread"

config SX9328_TRIGGER_OWN_THREAD
	depends on GPIO
	select SX9328_TRIGGER
	bool "Use own thread"

endchoice

config SX9328_TRIGGER
	bool

config SX9328_THREAD_STACK_SIZE
	int "Sensor delayed work thread stack size"
	depends on SX9328_TRIGGER_OWN_THREAD
	default 1024

config SX9328_THREAD_PRIORITY
	int "Thread priority"
	depends on SX9328_TRIGGER_OWN_THREAD
	default 10

endif # SX9328
```

## drivers/timer/Kconfig.gecko_letimer
```kconfig
# Copyright (c) 2023 T-Mobile USA, Inc.
# SPDX-License-Identifier: Apache-2.0

config GECKO_LETIMER
	bool "Gecko LETIMER"
	depends on SOC_FAMILY_EXX32
	depends on DT_HAS_SILABS_GECKO_LETIMER_ENABLED
	select SOC_GECKO_LETIMER
	select TICKLESS_CAPABLE
	select SYSTEM_TIMER_HAS_DISABLE_SUPPORT
	help
	  This module implements a kernel device driver for the Gecko LETIMER
	  and provides the standard "system clock driver" interfaces.

if GECKO_LETIMER

choice GECKO_LETIMER_OSCILLATOR
	prompt "LETIMER Oscillator configuration"
	default GECKO_LETIMER_USE_LFXO
	help
	  This option determines which Oscillator the LETIMER utilizes


config GECKO_LETIMER_USE_LFXO
	bool "LFXO"
	help
	  Use LFXO Oscillator to drive LETIMER

config GECKO_LETIMER_USE_LFRCO
	bool "LFRCO"
	help
	  Use LFRCO Oscillator to drive LETIMER

endchoice

config GECKO_LETIMER_USE_REP
	bool "Use repeat mode"
	help
		Use repeat mode for longer timers

endif # GECKO_LETIMER
```

## dts/bindings/adc/silabs,adc-gecko.yaml
```yaml
description: Silabs Gecko ADC node

compatible: "silabs,adc-gecko"

include: adc-controller.yaml

properties:
  reg:
    required: false 

  "#io-channel-cells":
    const: 1

  "num-channels":
    type: int
    required: true
    description:
      Number of channels available
  
  adc-channel-10:
    type: int
    required: true
    description:
      This property selects the ADC channel for battery voltage detection.

  adc-channel-23:
    type: int
    required: true
    description:
      This property selects the ADC channel for battery ID detection.

  frequency:
    type: int
    required: true
    description:
      This property selects the ADC source frequency: 

  en-gpios:
    type: phandle-array
    required: false
    description:
      Chip select enable/disable.

io-channel-cells:
  - input
```

## dts/bindings/adc/silabs,gecko-adc.yaml
```yaml
description: Silabs Gecko ADC node

compatible: "silabs,gecko-adc"

include: [adc-controller.yaml, pinctrl-device.yaml]

properties:

  "#io-channel-cells":
    const: 1

  num-channels:
    type: int
    description:
      Number of channels available

  frequency:
    type: int
    required: true
    description:
      This property selects the ADC source frequency.

  vbatt-aport:
    type: int
    description:
      This property selects the ADC channel for battery voltage detection.

  hwid-aport:
    type: int
    description:
      This property selects the ADC channel for battery ID detection.

  en-gpios:
    type: phandle-array
    description:
      Chip select enable/disable.

  vref-mv:
    type: int
    default: 3300
    description:
      Indicate the reference voltage of the ADC in mV.

io-channel-cells:
  - input
```

## dts/bindings/fuel-gauge/qorvo,act81461_alpc.yaml
```yaml
# Copyright (c) 2023 T-Mobile USA, Inc.
# SPDX-License-Identifier: Apache-2.0

description: |
  QORVO ACT81461 PMIC ALPC

compatible: "qorvo,act81461-alpc"

include: [base.yaml, fuel-gauge.yaml]
```

## dts/bindings/fuel-gauge/sbs,sbs-battery.yaml
```yaml
description: Silabs Gecko ADC node

compatible: "sbs,sbs-battery"

include: adc-controller.yaml

properties:
  reg:
    required: false 

  "#io-channel-cells":
    const: 1

  "num-channels":
    type: int
    required: true
    description:
      Number of channels available
  
  vbat-aport:
    type: int
    required: true
    description: |
      This property selects the ADC channel for battery voltage detection.

  hwid-aport:
    type: int
    required: true
    description: |
      This property selects the ADC channel for battery ID detection.

  frequency:
    type: int
    required: true
    description: |
      This property selects the ADC source frequency: 

  en-gpios:
    type: phandle-array
    required: false
    description: 
      Chip select enable/disable.

io-channel-cells:
  - input
```

## dts/bindings/hwinfo/silabs,gecko-hwinfo.yaml
```yaml
# Copyright (c) 2022 Antmicro
# SPDX-License-Identifier: Apache-2.0

description: Silabs Gecko HW info virtual device

compatible: "silabs,gecko-hwinfo"

include: base.yaml
```
