/*
 * Copyright (c) 2023 STMicroelectronics
 *
 * SPDX-License-Identifier: Apache-2.0
 */

/ {
	aliases {
		accel0 = &lsm6dsv16x_6b_x_nucleo_iks01a4;
	};
};

&arduino_i2c {

	lsm6dsv16x_6b_x_nucleo_iks01a4: lsm6dsv16x@6b {
		compatible = "st,lsm6dsv16x";
		reg = <0x6b>;
		accel-odr = <0x02>;
		gyro-odr = <0x02>;
		irq-gpios =  <&arduino_header 11 GPIO_ACTIVE_HIGH>; /* D5 */
		//irq-gpios =  <&arduino_header 10 GPIO_ACTIVE_HIGH>; /* D4 */
		drdy-pin = <1>;
		//drdy-pin = <2>;
	};
};
