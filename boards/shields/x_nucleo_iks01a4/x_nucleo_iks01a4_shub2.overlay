/*
 * Copyright (c) 2023 STMicroelectronics
 *
 * SPDX-License-Identifier: Apache-2.0
 */

/ {
	aliases {
		accel0 = &lsm6dso16is_6a_x_nucleo_iks01a4_shub;
	};
};

&arduino_i2c {

	lsm6dso16is_6a_x_nucleo_iks01a4_shub: lsm6dso16is@6a {
		compatible = "st,lsm6dso16is";
		reg = <0x6a>;
		irq-gpios =  <&arduino_header 5 GPIO_ACTIVE_HIGH>; /* A5 */
		//irq-gpios =  <&arduino_header 13 GPIO_ACTIVE_HIGH>; /* D7 */
		drdy-pin = <1>;
		//drdy-pin = <2>;
	};
};
