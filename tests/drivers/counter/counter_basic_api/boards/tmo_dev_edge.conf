## tests/drivers/counter/counter_basic_api/boards/tmo_dev_edge.conf
```kconfig
# Copyright (c) 2022 T-Mobile USA, Inc.
#
# SPDX-License-Identifier: Apache-2.0

CONFIG_COUNTER_GECKO_RTCC=y
```

## tests/drivers/eeprom/shell/testcase.yaml
```yaml
tests:
  drivers.eeprom.shell:
    platform_exclude: efm32pg_stk3402a
    integration_platforms:
      - native_posix
      - native_posix_64
    tags: drivers eeprom shell
```

## tests/drivers/hwinfo/api/testcase.yaml
```yaml
tests:
  drivers.hwinfo.api:
    platform_exclude: efm32pg_stk3402a
    tags: drivers hwinfo
```

## tests/drivers/ipm/testcase.yaml
```yaml
tests:
  drivers.ipc.mailbox:
    platform_exclude: efm32pg_stk3402a
    arch_exclude: posix xtensa
    tags: drivers ipc
```

## tests/drivers/mm/sys_mm_drv_api/testcase.yaml
```yaml
tests:
  drivers.mm.sys_mm_drv_api:
    platform_exclude: efm32pg_stk3402a
    tags: drivers mm
```

## tests/drivers/sensor/als/testcase.yaml
```yaml
tests:
  drivers.sensor.als:
    tags:
      - drivers
      - sensor
      - subsys
    integration_platforms:
      - tmo_dev_edge
```

## tests/drivers/sensor/generic/testcase.yaml
```yaml
common:
  integration_platforms:
    - qemu_x86
    - mps2_an385
tests:
  drivers.sensor.generic:
    platform_exclude: efm32pg_stk3402a
    tags: drivers sensor
  drivers.sensor.generic.fpu:
    platform_exclude: efm32pg_stk3402a
    extra_args: CONF_FILE=prj_fpu.conf
    tags: drivers sensor
```

## tests/kernel/early_sleep/testcase.yaml
```yaml
tests:
  kernel.common.sleep:
    platform_exclude: efm32pg_stk3402a
    tags: kernel sleep
  kernel.common.sleep.linker_generator:
    platform_allow: qemu_cortex_m3
    tags: linker_generator
    extra_configs:
      - CONFIG_CMAKE_LINKER_GENERATOR=y
```

## tests/kernel/fifo/fifo_timeout/testcase.yaml
```yaml
tests:
  kernel.fifo.timeout:
    platform_exclude: efm32pg_stk3402a
    tags: kernel
  kernel.fifo.timeout.linker_generator:
    platform_allow: qemu_cortex_m3
    tags: linker_generator
    extra_configs:
      - CONFIG_CMAKE_LINKER_GENERATOR=y
```

## tests/kernel/mem_protect/stack_random/testcase.yaml
```yaml
tests:
  kernel.memory_protection.stack_random:
    platform_exclude: efm32pg_stk3402a
    arch_exclude: posix
    tags: kernel memory_protection
```

## tests/kernel/mem_protect/stackprot/testcase.yaml
```yaml
tests:
  kernel.memory_protection.stackprot:
    platform_exclude: efm32pg_stk3402a
    arch_exclude: nios2 xtensa posix sparc
    tags: kernel userspace
    ignore_faults: true
```

## tests/kernel/mem_slab/mslab/testcase.yaml
```yaml
tests:
  kernel.memory_slabs:
    tags:
      - kernel
      - memory_slabs
    platform_exclude: tmo_dev_edge
```

## tests/kernel/obj_tracking/testcase.yaml
```yaml
tests:
  kernel.objects.tracking:
    tags: kernel
    platform_exclude: qemu_x86_tiny efm32pg_stk3402a
```

## tests/kernel/pending/testcase.yaml
```yaml
tests:
  kernel.objects:
    platform_exclude: efm32pg_stk3402a
    tags: kernel
```

## tests/kernel/sched/schedule_api/testcase.yaml
```yaml
common:
  timeout: 180
  min_ram: 34
  tags: kernel threads scheduler userspace
  ignore_faults: true
tests:
  kernel.scheduler:
    filter: not CONFIG_SCHED_MULTIQ
    extra_configs:
      - CONFIG_TIMESLICING=y
  kernel.scheduler.no_timeslicing:
    filter: not CONFIG_SCHED_MULTIQ
    extra_configs:
      - CONFIG_TIMESLICING=n
  kernel.scheduler.slice_perthread:
    platform_exclude: efm32pg_stk3402a
    filter: not CONFIG_SCHED_MULTIQ
    extra_configs:
      - CONFIG_TIMESLICING=y
      - CONFIG_TIMESLICE_PER_THREAD=y
  kernel.scheduler.multiq:
    extra_args: CONF_FILE=prj_multiq.conf
    extra_configs:
      - CONFIG_TIMESLICING=y
  kernel.scheduler.multiq_no_timeslicing:
    extra_args: CONF_FILE=prj_multiq.conf
    extra_configs:
      - CONFIG_TIMESLICING=n
  kernel.scheduler.dumb_timeslicing:
    platform_exclude: efm32pg_stk3402a
    extra_args: CONF_FILE=prj_dumb.conf
    extra_configs:
      - CONFIG_TIMESLICING=y
  kernel.scheduler.dumb_no_timeslicing:
    platform_exclude: efm32pg_stk3402a
    extra_args: CONF_FILE=prj_dumb.conf
    extra_configs:
      - CONFIG_TIMESLICING=n
  kernel.scheduler.linker_generator:
    filter: not CONFIG_SCHED_MULTIQ
    platform_allow: qemu_cortex_m3
    extra_configs:
      - CONFIG_TIMESLICING=y
      - CONFIG_CMAKE_LINKER_GENERATOR=y
    tags: linker_generator
```

## tests/kernel/threads/dynamic_thread/testcase.yaml
```yaml
tests:
  kernel.threads.dynamic:
    platform_exclude: efm32pg_stk3402a
    tags: kernel threads userspace
    ignore_faults: true
    filter: CONFIG_ARCH_HAS_USERSPACE
```

## tests/kernel/threads/thread_error_case/testcase.yaml
```yaml
tests:
  kernel.threads.error.case:
    platform_exclude: efm32pg_stk3402a
    tags: kernel threads userspace
    filter: CONFIG_USERSPACE
    ignore_faults: true
```

## tests/kernel/workq/work_queue/testcase.yaml
```yaml
tests:
  kernel.workqueue:
    min_flash: 34
    tags:
      - kernel
      - workqueue
    platform_exclude: tmo_dev_edge
```

## tests/lib/c_lib/testcase.yaml
```yaml
common:
  tags: clib
  platform_exclude: native_posix native_posix_64 nrf52_bsim
tests:
  libraries.libc:
    platform_exclude: efm32pg_stk3402a
    ignore_faults: true
  libraries.libc.picolibc:
    platform_exclude: efm32pg_stk3402a
    filter: CONFIG_PICOLIBC_SUPPORTED
    tags: picolibc
    ignore_faults: true
    extra_configs:
      - CONFIG_PICOLIBC=y
  libraries.libc.minimal.strerror_table:
    platform_exclude: efm32pg_stk3402a
    extra_configs:
      - CONFIG_MINIMAL_LIBC=y
      - CONFIG_MINIMAL_LIBC_STRING_ERROR_TABLE=y
  libraries.libc.minimal.no_strerror_table:
    platform_exclude: efm32pg_stk3402a
    extra_configs:
      - CONFIG_MINIMAL_LIBC=y
      - CONFIG_MINIMAL_LIBC_STRING_ERROR_TABLE=n
```

## tests/lib/cbprintf_fp/testcase.yaml
```yaml
common:
  harness: console
  platform_exclude: native_posix native_posix_64 nrf52_bsim
  tags: cbprintf
  integration_platforms:
    - qemu_x86
    - qemu_x86_64
  filter: CONFIG_CONSOLE_HAS_DRIVER
tests:
  libraries.cbprintf_fp.printk:
    platform_exclude: efm32pg_stk3402a
    extra_configs:
      - CONFIG_APP_FORMATTER_PRINTK=y
    harness_config:
      type: multi_line
      ordered: true
      regex:
        - "Hello with printk"
        - "Complete"
  libraries.cbprintf_fp.printf:
    platform_exclude: efm32pg_stk3402a
    extra_configs:
      - CONFIG_APP_FORMATTER_PRINTF=y
    harness_config:
      type: multi_line
      ordered: true
      regex:
        - "Hello with printf"
        - "Complete"
  libraries.cbprintf_fp.printf_nl:
    platform_exclude: efm32pg_stk3402a
    filter: TOOLCHAIN_HAS_NEWLIB == 1
    extra_configs:
      - CONFIG_APP_FORMATTER_PRINTF=y
      - CONFIG_NEWLIB_LIBC=y
    harness_config:
      type: multi_line
      ordered: true
      regex:
        - "Hello with printf/newlib"
        - "Complete"
  libraries.cbprintf_fp.printfcb:
    platform_exclude: efm32pg_stk3402a
    extra_configs:
      - CONFIG_APP_FORMATTER_PRINTFCB=y
    harness_config:
      type: multi_line
      ordered: true
      regex:
        - "Hello with printfcb"
        - "Complete"
  libraries.cbprintf_fp.printfcb_nl:
    platform_exclude: efm32pg_stk3402a
    filter: TOOLCHAIN_HAS_NEWLIB == 1
    extra_configs:
      - CONFIG_APP_FORMATTER_PRINTFCB=y
      - CONFIG_NEWLIB_LIBC=y
    harness_config:
      type: multi_line
      ordered: true
      regex:
        - "Hello with printfcb/newlib"
        - "Complete"
  libraries.cbprintf_fp.fprintf:
    platform_exclude: efm32pg_stk3402a
    extra_configs:
      - CONFIG_APP_FORMATTER_FPRINTF=y
    harness_config:
      type: multi_line
      ordered: true
      regex:
        - "Hello with fprintf"
        - "Complete"
  libraries.cbprintf_fp.fprintfcb:
    platform_exclude: efm32pg_stk3402a
    extra_configs:
      - CONFIG_APP_FORMATTER_FPRINTFCB=y
    harness_config:
      type: multi_line
      ordered: true
      regex:
        - "Hello with fprintfcb"
        - "Complete"
  libraries.cbprintf_fp.printf.picolibc:
    platform_exclude: efm32pg_stk3402a
    filter: CONFIG_PICOLIBC_SUPPORTED
    tags: picolibc
    extra_configs:
      - CONFIG_APP_FORMATTER_PRINTF=y
      - CONFIG_PICOLIBC=y
    harness_config:
      type: multi_line
      ordered: true
      regex:
        - "Hello with printf"
        - "Complete"
  libraries.cbprintf_fp.printfcb.picolibc:
    platform_exclude: efm32pg_stk3402a
    filter: CONFIG_PICOLIBC_SUPPORTED
    tags: picolibc
    extra_configs:
      - CONFIG_APP_FORMATTER_PRINTFCB=y
      - CONFIG_PICOLIBC=y
    harness_config:
      type: multi_line
      ordered: true
      regex:
        - "Hello with printfcb"
        - "Complete"
```

## tests/lib/cmsis_dsp/filtering/testcase.yaml
```yaml
common:
  toolchain_exclude: llvm

tests:
  libraries.cmsis_dsp.filtering:
    filter: ((CONFIG_CPU_AARCH32_CORTEX_R or CONFIG_CPU_CORTEX_M) and TOOLCHAIN_HAS_NEWLIB == 1) or
      CONFIG_ARCH_POSIX
    tags: cmsis_dsp
    skip: true
  libraries.cmsis_dsp.filtering.biquad:
    platform_exclude: efm32pg_stk3402a
    filter: ((CONFIG_CPU_AARCH32_CORTEX_R or CONFIG_CPU_CORTEX_M) and TOOLCHAIN_HAS_NEWLIB == 1) or
      CONFIG_ARCH_POSIX
    integration_platforms:
      - frdm_k64f
      - sam_e70_xplained
      - mps2_an521
      - native_posix
    tags: cmsis_dsp
    min_flash: 128
    min_ram: 64
    extra_args: CONF_FILE=prj_base.conf
    extra_configs:
      - CONFIG_CMSIS_DSP_TEST_FILTERING_BIQUAD=y
  libraries.cmsis_dsp.filtering.biquad.fpu:
    platform_exclude: efm32pg_stk3402a
    filter: ((CONFIG_CPU_AARCH32_CORTEX_R or CONFIG_CPU_CORTEX_M) and CONFIG_CPU_HAS_FPU and
      TOOLCHAIN_HAS_NEWLIB == 1) or CONFIG_ARCH_POSIX
    integration_platforms:
      - mps2_an521_remote
      - mps3_an547
    tags: cmsis_dsp fpu
    min_flash: 128
    min_ram: 64
    extra_args: CONF_FILE=prj_base.conf
    extra_configs:
      - CONFIG_CMSIS_DSP_TEST_FILTERING_BIQUAD=y
      - CONFIG_FPU=y
  libraries.cmsis_dsp.filtering.decim:
    platform_exclude: efm32pg_stk3402a
    filter: ((CONFIG_CPU_AARCH32_CORTEX_R or CONFIG_CPU_CORTEX_M) and TOOLCHAIN_HAS_NEWLIB == 1) or
      CONFIG_ARCH_POSIX
    integration_platforms:
      - frdm_k64f
      - sam_e70_xplained
      - mps2_an521
      - native_posix
    tags: cmsis_dsp
    min_flash: 128
    min_ram: 64
    extra_args: CONF_FILE=prj_base.conf
    extra_configs:
      - CONFIG_CMSIS_DSP_TEST_FILTERING_DECIM=y
  libraries.cmsis_dsp.filtering.decim.fpu:
    platform_exclude: efm32pg_stk3402a
    filter: ((CONFIG_CPU_AARCH32_CORTEX_R or CONFIG_CPU_CORTEX_M) and CONFIG_CPU_HAS_FPU and
      TOOLCHAIN_HAS_NEWLIB == 1) or CONFIG_ARCH_POSIX
    integration_platforms:
      - mps2_an521_remote
      - mps3_an547
    tags: cmsis_dsp fpu
    min_flash: 128
    min_ram: 64
    extra_args: CONF_FILE=prj_base.conf
    extra_configs:
      - CONFIG_CMSIS_DSP_TEST_FILTERING_DECIM=y
      - CONFIG_FPU=y
  libraries.cmsis_dsp.filtering.fir:
    platform_exclude: efm32pg_stk3402a
    filter: ((CONFIG_CPU_AARCH32_CORTEX_R or CONFIG_CPU_CORTEX_M) and TOOLCHAIN_HAS_NEWLIB == 1) or
      CONFIG_ARCH_POSIX
    integration_platforms:
      - frdm_k64f
      - sam_e70_xplained
      - mps2_an521
      - native_posix
    tags: cmsis_dsp
    min_flash: 128
    min_ram: 64
    extra_args: CONF_FILE=prj_base.conf
    extra_configs:
      - CONFIG_CMSIS_DSP_TEST_FILTERING_FIR=y
  libraries.cmsis_dsp.filtering.fir.fpu:
    platform_exclude: efm32pg_stk3402a
    filter: ((CONFIG_CPU_AARCH32_CORTEX_R or CONFIG_CPU_CORTEX_M) and CONFIG_CPU_HAS_FPU and
      TOOLCHAIN_HAS_NEWLIB == 1) or CONFIG_ARCH_POSIX
    integration_platforms:
      - mps2_an521_remote
      - mps3_an547
    tags: cmsis_dsp fpu
    min_flash: 128
    min_ram: 64
    extra_args: CONF_FILE=prj_base.conf
    extra_configs:
      - CONFIG_CMSIS_DSP_TEST_FILTERING_FIR=y
      - CONFIG_FPU=y
  libraries.cmsis_dsp.filtering.misc:
    platform_exclude: efm32pg_stk3402a
    filter: ((CONFIG_CPU_AARCH32_CORTEX_R or CONFIG_CPU_CORTEX_M) and TOOLCHAIN_HAS_NEWLIB == 1) or
      CONFIG_ARCH_POSIX
    integration_platforms:
      - frdm_k64f
      - sam_e70_xplained
      - mps2_an521
      - native_posix
    tags: cmsis_dsp
    min_flash: 256
    min_ram: 64
    extra_args: CONF_FILE=prj_base.conf
    extra_configs:
      - CONFIG_CMSIS_DSP_TEST_FILTERING_MISC=y
  libraries.cmsis_dsp.filtering.misc.fpu:
    platform_exclude: efm32pg_stk3402a
    filter: ((CONFIG_CPU_AARCH32_CORTEX_R or CONFIG_CPU_CORTEX_M) and CONFIG_CPU_HAS_FPU and
      TOOLCHAIN_HAS_NEWLIB == 1) or CONFIG_ARCH_POSIX
    integration_platforms:
      - mps2_an521_remote
      - mps3_an547
    tags: cmsis_dsp fpu
    min_flash: 256
    min_ram: 64
    extra_args: CONF_FILE=prj_base.conf
    extra_configs:
      - CONFIG_CMSIS_DSP_TEST_FILTERING_MISC=y
      - CONFIG_FPU=y
```

## tests/lib/cmsis_nn/testcase.yaml
```yaml
tests:
  libraries.cmsis_nn:
    platform_exclude: efm32pg_stk3402a
    filter: CONFIG_CPU_CORTEX_M and TOOLCHAIN_HAS_NEWLIB == 1
    integration_platforms:
      - frdm_k64f
      - sam_e70_xplained
      - mps2_an521
    tags: cmsis_nn
    min_flash: 64
    min_ram: 32
```

## tests/lib/devicetree/api_ext/testcase.yaml
```yaml
tests:
  libraries.devicetree.api_ext:
    platform_exclude: efm32pg_stk3402a
    tags: devicetree
    # We only need this to run on one platform so use native_posix as it
    # will mostly likely be the fastest.
    integration_platforms:
      - native_posix
```

## tests/lib/fdtable/testcase.yaml
```yaml
tests:
  libraries.os.fdtable:
    platform_exclude: efm32pg_stk3402a
    tags: fdtable
    integration_platforms:
      - qemu_x86
```

## tests/lib/heap_align/testcase.yaml
```yaml
tests:
  libraries.heap_align:
    platform_exclude: efm32pg_stk3402a
    tags: heap heap_align
```
