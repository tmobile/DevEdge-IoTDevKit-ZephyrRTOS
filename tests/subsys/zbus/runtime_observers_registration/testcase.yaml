## tests/subsys/zbus/runtime_observers_registration/testcase.yaml
```yaml
tests:
  message_bus.zbus.runtime_obs_reg.add_and_remove_observers:
    platform_exclude: efm32pg_stk3402a
    tags: zbus
```

## tests/subsys/zbus/user_data/testcase.yaml
```yaml
tests:
  message_bus.zbus.user_data.channel_user_data:
    platform_exclude: fvp_base_revc_2xaemv8a_smp_ns efm32pg_stk3402a
    tags: zbus
```
