## tests/lib/json/testcase.yaml
```yaml
tests:
  libraries.encoding.json:
    platform_exclude: efm32pg_stk3402a
    filter: not CONFIG_NEWLIB_LIBC
    min_flash: 34
    tags: json
    integration_platforms:
      - native_posix
```

## tests/lib/linear_range/testcase.yaml
```yaml
# Copyright (c) 2022 Nordic Semiconductor ASA
# SPDX-License-Identifier: Apache-2.0

tests:
  libraries.linear_range:
    platform_exclude: efm32pg_stk3402a
    integration_platforms:
      - native_posix
```

## tests/lib/mem_blocks/testcase.yaml
```yaml
tests:
  libraries.mem_blocks:
    platform_exclude: efm32pg_stk3402a
    tags: heap mem_blocks
```

## tests/lib/mem_blocks_stats/testcase.yaml
```yaml
tests:
  libraries.mem_blocks.stats:
    platform_exclude: efm32pg_stk3402a
    tags: heap mem_blocks.stats
```

## tests/lib/newlib/heap_listener/testcase.yaml
```yaml
tests:
  libraries.libc.newlib.heap_listener:
    platform_exclude: efm32pg_stk3402a
    tags: clib newlib
    filter: TOOLCHAIN_HAS_NEWLIB == 1
```

## tests/lib/notify/testcase.yaml
```yaml
tests:
  libraries.data_structures:
    platform_exclude: efm32pg_stk3402a
    tags: notify
    integration_platforms:
      - native_posix
```

## tests/lib/onoff/testcase.yaml
```yaml
tests:
  libraries.onoff:
    platform_exclude: efm32pg_stk3402a
    tags: onoff timer
    integration_platforms:
      - native_posix
```

## tests/lib/ringbuffer/testcase.yaml
```yaml
common:
  tags: ring_buffer circular_buffer
  timeout: 150

tests:
  libraries.ring_buffer:
    platform_exclude: efm32pg_stk3402a
    integration_platforms:
      - native_posix
      - native_posix_64

  libraries.ring_buffer_concurrent:
    platform_allow: qemu_x86
    extra_configs:
      - CONFIG_SYS_CLOCK_TICKS_PER_SEC=100000
    integration_platforms:
      - qemu_x86
```

## tests/lib/smf/testcase.yaml
```yaml
common:
  integration_platforms:
    - native_posix
tests:
  libraries.smf.flat:
    platform_exclude: efm32pg_stk3402a
    tags: smf
    testcases:
      - smf_flat
  libraries.smf.hierarchical:
    platform_exclude: efm32pg_stk3402a
    extra_configs:
      - CONFIG_SMF_ANCESTOR_SUPPORT=y
    tags: smf
    testcases:
      - smf_hierarchical_5_ancestors
      - smf_hierarchical
```

## tests/lib/sys_util/testcase.yaml
```yaml
tests:
  libraries.sys_util:
    platform_exclude: efm32pg_stk3402a
    tags: sys_util
```

## tests/lib/time/testcase.yaml
```yaml
tests:
  libraries.libc.time:
    platform_exclude: efm32pg_stk3402a
    tags: libc
    filter: not CONFIG_ARCH_POSIX or CONFIG_NATIVE_POSIX_SLOWDOWN_TO_REAL_TIME
    timeout: 180
    integration_platforms:
      - mps2_an385
```

## tests/misc/iterable_sections/testcase.yaml
```yaml
tests:
  misc.iterable_sections:
    platform_exclude: efm32pg_stk3402a
    tags: iterable_sections
    arch_exclude: xtensa
```

## tests/posix/eventfd/testcase.yaml
```yaml
common:
  arch_exclude: posix
  tags: posix eventfd
tests:
  portability.posix.eventfd:
    platform_exclude: efm32pg_stk3402a
    min_ram: 32
  portability.posix.eventfd.newlib:
    platform_exclude: efm32pg_stk3402a
    min_ram: 32
    filter: TOOLCHAIN_HAS_NEWLIB == 1
    extra_configs:
      - CONFIG_NEWLIB_LIBC=y
  portability.posix.eventfd.picolibc:
    platform_exclude: efm32pg_stk3402a
    tags: picolibc
    filter: CONFIG_PICOLIBC_SUPPORTED
    extra_configs:
      - CONFIG_PICOLIBC=y
```

## tests/posix/eventfd_basic/testcase.yaml
```yaml
common:
  arch_exclude: posix
  tags: posix eventfd
  min_ram: 32
tests:
  portability.posix.eventfd_basic:
    platform_exclude: efm32pg_stk3402a
    extra_configs:
      - CONFIG_POSIX_API=n
  portability.posix.eventfd_basic.posix_api:
    platform_exclude: efm32pg_stk3402a
    extra_configs:
      - CONFIG_POSIX_API=y
  portability.posix.eventfd_basic.newlib:
    platform_exclude: efm32pg_stk3402a
    filter: TOOLCHAIN_HAS_NEWLIB == 1
    extra_configs:
      - CONFIG_NEWLIB_LIBC=y
      - CONFIG_POSIX_API=n
  portability.posix.eventfd_basic.newlib.posix_api:
    platform_exclude: efm32pg_stk3402a
    filter: TOOLCHAIN_HAS_NEWLIB == 1
    extra_configs:
      - CONFIG_NEWLIB_LIBC=y
      - CONFIG_POSIX_API=y
  portability.posix.eventfd_basic.picolibc:
    platform_exclude: efm32pg_stk3402a
    tags: picolibc
    filter: CONFIG_PICOLIBC_SUPPORTED
    extra_configs:
      - CONFIG_PICOLIBC=y
  portability.posix.eventfd_basic.picolibc.posix_api:
    platform_exclude: efm32pg_stk3402a
    tags: picolibc
    filter: CONFIG_PICOLIBC_SUPPORTED
    extra_configs:
      - CONFIG_PICOLIBC=y
```

## tests/posix/fs/testcase.yaml
```yaml
common:
  arch_exclude: nios2 posix
  tags: posix filesystem
  min_ram: 128
  modules:
    - fatfs
tests:
  portability.posix.fs:
    platform_exclude: efm32pg_stk3402a
    extra_configs:
      - CONFIG_NEWLIB_LIBC=n
  portability.posix.fs.newlib:
    platform_exclude: efm32pg_stk3402a
    filter: TOOLCHAIN_HAS_NEWLIB == 1
    extra_configs:
      - CONFIG_NEWLIB_LIBC=y
  portability.posix.fs.tls:
    platform_exclude: efm32pg_stk3402a
    filter: CONFIG_ARCH_HAS_THREAD_LOCAL_STORAGE and CONFIG_TOOLCHAIN_SUPPORTS_THREAD_LOCAL_STORAGE
    extra_configs:
      - CONFIG_NEWLIB_LIBC=n
      - CONFIG_THREAD_LOCAL_STORAGE=y
  portability.posix.fs.tls.newlib:
    platform_exclude: efm32pg_stk3402a
    filter: TOOLCHAIN_HAS_NEWLIB == 1 and CONFIG_ARCH_HAS_THREAD_LOCAL_STORAGE and
      CONFIG_TOOLCHAIN_SUPPORTS_THREAD_LOCAL_STORAGE
    extra_configs:
      - CONFIG_NEWLIB_LIBC=y
      - CONFIG_THREAD_LOCAL_STORAGE=y
  portability.posix.fs.picolibc:
    platform_exclude: efm32pg_stk3402a
    tags: picolibc
    filter: CONFIG_PICOLIBC_SUPPORTED
    extra_configs:
      - CONFIG_PICOLIBC=y
  portability.posix.fs.tls.picolibc:
    platform_exclude: efm32pg_stk3402a
    tags: picolibc
    filter: CONFIG_PICOLIBC_SUPPORTED
    extra_configs:
      - CONFIG_PICOLIBC=y
```

## tests/posix/getopt/testcase.yaml
```yaml
common:
  arch_exclude: posix
  tags: posix getopt
tests:
  portability.posix.getopt:
    platform_exclude: efm32pg_stk3402a
    integration_platforms:
      - qemu_x86
    min_flash: 64
    min_ram: 32
  portability.posix.getopt.newlib:
    platform_exclude: efm32pg_stk3402a
    filter: TOOLCHAIN_HAS_NEWLIB == 1
    extra_configs:
      - CONFIG_NEWLIB_LIBC=y
  portability.posix.getopt.picolibc:
    platform_exclude: efm32pg_stk3402a
    tags: picolibc
    filter: CONFIG_PICOLIBC_SUPPORTED
    extra_configs:
      - CONFIG_PICOLIBC=y
```

## tests/subsys/input/api/testcase.yaml
```yaml
# SPDX-License-Identifier: Apache-2.0

tests:
  input.api.thread:
    platform_exclude: efm32pg_stk3402a
    tags: input
    integration_platforms:
      - native_posix
    extra_configs:
      - CONFIG_INPUT_MODE_THREAD=y
      - CONFIG_INPUT_THREAD_STACK_SIZE=1024
  input.api.synchronous:
    platform_exclude: efm32pg_stk3402a
    tags: input
    integration_platforms:
      - native_posix
    extra_configs:
      - CONFIG_INPUT_MODE_SYNCHRONOUS=y
```

## tests/subsys/mgmt/mcumgr/os_mgmt_echo/testcase.yaml
```yaml
#
# Copyright (c) 2022 Nordic Semiconductor ASA
#
# SPDX-License-Identifier: Apache-2.0
#
tests:
  mgmt.mcumgr.os.echo:
    # FIXME: Exclude architectures that lack a reboot handler function
    platform_exclude: efm32pg_stk3402a
    arch_exclude: arm64 nios2 sparc arc xtensa mips
    tags: os_mgmt_echo mcumgr mgmt
```

## tests/subsys/pm/device_runtime_api/testcase.yaml
```yaml
tests:
  pm.device_runtime.api:
    platform_exclude: efm32pg_stk3402a
    tags: pm
```

## tests/subsys/portability/cmsis_rtos_v1/testcase.yaml
```yaml
tests:
  portability.cmsis_rtos_v1:
    platform_exclude: efm32pg_stk3402a
    tags: cmsis_rtos
    min_ram: 32
    min_flash: 34
```

## tests/subsys/rtio/rtio_api/testcase.yaml
```yaml
common:
  platform_exclude: m2gl025_miv
  platform_key:
    - arch
    - simulation
tests:
  rtio.api:
    filter: not CONFIG_ARCH_HAS_USERSPACE
    tags: rtio
  rtio.api.submit_sem:
    filter: not CONFIG_ARCH_HAS_USERSPACE
    tags: rtio
    extra_configs:
      - CONFIG_RTIO_SUBMIT_SEM=y
  rtio.api.userspace:
    platform_exclude: efm32pg_stk3402a
    filter: CONFIG_ARCH_HAS_USERSPACE
    extra_configs:
      - CONFIG_USERSPACE=y
    tags: rtio userspace
  rtio.api.userspace.submit_sem:
    platform_exclude: efm32pg_stk3402a
    filter: CONFIG_ARCH_HAS_USERSPACE
    extra_configs:
      - CONFIG_USERSPACE=y
      - CONFIG_RTIO_SUBMIT_SEM=y
    tags: rtio userspace
```

## tests/subsys/settings/nvs/testcase.yaml
```yaml
tests:
  system.settings.nvs:
    platform_exclude: efm32pg_stk3402a
    depends_on: nvs
    min_ram: 32
    tags: settings_nvs
```

## tests/subsys/shell/shell_history/testcase.yaml
```yaml
tests:
  shell.history:
    platform_exclude: efm32pg_stk3402a
    integration_platforms:
      - native_posix
    min_flash: 64
    min_ram: 32
    filter: ( CONFIG_SHELL )
    tags: shell
```

## tests/subsys/zbus/integration/testcase.yaml
```yaml
tests:
  message_bus.zbus.module_interaction_no_error:
    platform_exclude: qemu_cortex_a9 hifive_unleashed fvp_base_revc_2xaemv8a_smp_ns
      efm32pg_stk3402a
    tags: zbus
```
