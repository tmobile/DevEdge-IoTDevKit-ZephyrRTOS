## dts/bindings/timer/silabs,gecko-letimer.yaml
```yaml
# Copyright (c) 2023 T-Mobile USA, Inc.
# SPDX-License-Identifier: Apache-2.0

description: Silabs gecko LETimer node

compatible: "silabs,gecko-letimer"

include: base.yaml

properties:
  reg:
    required: true

  interrupts:
    required: true

  prescaler:
    type: int
    default: 1
    description: prescaling factor from the LFXO/LRRCO clock
    enum:
      - 1
      - 2
      - 4
      - 8
      - 16
      - 32
      - 64
      - 128
      - 256
      - 512
      - 1024
      - 2048
      - 4096
      - 8192
      - 16384
      - 32768
```

## samples/application_development/external_lib/sample.yaml
```yaml
sample:
  name: External Library
tests:
  sample.app_dev.external_lib:
    platform_exclude: efm32pg_stk3402a
    integration_platforms:
      - native_posix
    tags: external
    harness: console
    harness_config:
      type: multi_line
      regex:
        - "Hello World!"
        - "mylib says: Hello World!"
```

## samples/bluetooth/peripheral_ht/boards/tmo_dev_edge.conf
```kconfig
# Copyright (c) 2023 T-Mobile USA, Inc.
#
# SPDX-License-Identifier: Apache-2.0

CONFIG_SPI=y
CONFIG_BT_CUSTOM=y
CONFIG_BT_RS9116W=y
CONFIG_BT_DEBUG_LOG=n
```

## samples/cpp/cpp_synchronization/sample.yaml
```yaml
sample:
  name: Syncronisation (C++)
tests:
  sample.cpp.synchronization:
    platform_exclude: efm32pg_stk3402a
    tags: cpp
    toolchain_exclude: issm xcc
    integration_platforms:
      - qemu_x86
    harness: console
    harness_config:
      type: multi_line
      regex:
        - "Create semaphore (.*)"
        - "main: Hello World!"
        - "coop_thread_entry: Hello World!"
  sample.cpp.synchronization.picolibc:
    filter: CONFIG_PICOLIBC_SUPPORTED
    extra_configs:
      - CONFIG_PICOLIBC=y
    tags: cpp
    toolchain_exclude: issm xcc
    integration_platforms:
      - qemu_x86
    harness: console
    harness_config:
      type: multi_line
      regex:
        - "Create semaphore (.*)"
        - "main: Hello World!"
        - "coop_thread_entry: Hello World!"
```

## samples/hello_world/sample.yaml
```yaml
sample:
  description: Hello World sample, the simplest Zephyr
    application
  name: hello world
common:
  tags: introduction
  integration_platforms:
    - native_posix
  harness: console
  harness_config:
    type: one_line
    regex:
      - "Hello World! (.*)"
tests:
  sample.basic.helloworld:
    platform_exclude: efm32pg_stk3402a
    tags: introduction
```

## samples/kernel/condition_variables/condvar/sample.yaml
```yaml
tests:
  sample.kernel.cond_var:
    platform_exclude: efm32pg_stk3402a
    integration_platforms:
      - native_posix
    tags: kernel condition_variables
    harness: console
    harness_config:
      type: one_line
      regex:
        - ".*Waited and joined with 3 threads"
```

## samples/kernel/condition_variables/simple/sample.yaml
```yaml
tests:
  sample.kernel.cond_var.simple:
    platform_exclude: efm32pg_stk3402a
    integration_platforms:
      - native_posix
    tags: kernel condition_variables
    harness: console
    harness_config:
      type: one_line
      regex:
        - ".*done == 20 so everyone is done"
```

## samples/modules/nanopb/sample.yaml
```yaml
sample:
  description: Nanopb sample, with a simple proto
    buffer
  name: Simple nanopb
common:
  modules:
    - nanopb
  harness: console
  harness_config:
    type: one_line
    regex:
      - "Your lucky number was 13!"
tests:
  sample.modules.nanopb:
    platform_exclude: efm32pg_stk3402a
    tags: samples nanopb
    integration_platforms:
      - native_posix
      - native_posix_64
```

## samples/philosophers/sample.yaml
```yaml
sample:
  name: Dining Philosophers
common:
  extra_args: DEBUG_PRINTF=1
  tags: introduction
  harness: console
  integration_platforms:
    - native_posix
  harness_config:
    type: multi_line
    ordered: false
    regex:
      - ".*STARVING.*"
      - ".*DROPPED ONE FORK.*"
      - ".*THINKING.*"
      - ".*EATING.*"
tests:
  sample.kernel.philosopher:
    platform_exclude: efm32pg_stk3402a
    tags: introduction
  sample.kernel.philosopher.same_prio:
    platform_exclude: efm32pg_stk3402a
    extra_args: SAME_PRIO=1
  sample.kernel.philosopher.static:
    platform_exclude: efm32pg_stk3402a
    extra_args: STATIC_OBJS=1
  sample.kernel.philosopher.semaphores:
    platform_exclude: efm32pg_stk3402a
    extra_args: FORKS=SEMAPHORES
  sample.kernel.philosopher.stacks:
    extra_args: FORKS=STACKS
    platform_exclude: efm32pg_stk3402a
  sample.kernel.philosopher.fifos:
    platform_exclude: efm32pg_stk3402a
    extra_args: FORKS=FIFOS
  sample.kernel.philosopher.lifos:
    platform_exclude: efm32pg_stk3402a
    extra_args: FORKS=LIFOS
  sample.kernel.philosopher.preempt_only:
    platform_exclude: efm32pg_stk3402a
    extra_configs:
      - CONFIG_NUM_PREEMPT_PRIORITIES=6
      - CONFIG_NUM_COOP_PRIORITIES=0
      - CONFIG_BT=n
      - CONFIG_NETWORKING=n
  sample.kernel.philosopher.coop_only:
    platform_exclude: efm32pg_stk3402a
    extra_configs:
      - CONFIG_NUM_PREEMPT_PRIORITIES=0
      - CONFIG_NUM_COOP_PRIORITIES=7
```

## samples/sensor/sx9328/sample.yaml
```yaml
sample:
  name: SX9328 Sensor Sample
tests:
  sample.sensor.sx9328:
    harness: sensor
    tags: sensors
    depends_on: i2c gpio
    filter: dt_compat_enabled("semtech,sx9328")
```

## samples/subsys/portability/cmsis_rtos_v1/philosophers/sample.yaml
```yaml
sample:
  name: CMSIS_RTOS_V1 Dining Philosophers
common:
  integration_platforms:
    - native_posix
  extra_args: DEBUG_PRINTF=1
  tags: cmsis_rtos
  min_ram: 32
  min_flash: 34
  harness: console
  harness_config:
    type: multi_line
    ordered: false
    regex:
      - ".*STARVING.*"
      - ".*HOLDING.*"
      - ".*EATING.*"
      - ".*DROPPED ONE FORK.*"
      - ".*THINKING.*"
tests:
  sample.portability.cmsis_rtos_v1.philosopher:
    platform_exclude: efm32pg_stk3402a
    tags: cmsis_rtos
  sample.portability.cmsis_rtos_v1.philosopher.same_prio:
    platform_exclude: efm32pg_stk3402a
    extra_args: SAME_PRIO=1
  sample.portability.cmsis_rtos_v1.philosopher.semaphores:
    platform_exclude: efm32pg_stk3402a
    extra_args: FORKS=SEMAPHORES
```

## samples/subsys/rtio/sensor_batch_processing/sample.yaml
```yaml
sample:
  name: RTIO sample
tests:
  sample.rtio.sensor_batch_processing:
    platform_exclude: efm32pg_stk3402a
    tags: rtio
    integration_platforms:
      - native_posix
    harness: console
    harness_config:
      type: multi_line
      regex:
        - "(.*)Submitting (.*) read requests"
        - "(.*)Start processing (.*) samples"
        - "(.*)Finished processing (.*) samples"
```

## samples/subsys/shell/fs/boards/tmo_dev_edge.conf
```kconfig
# Copyright (c) 2023 T-Mobile USA, Inc.
#
# SPDX-License-Identifier: Apache-2.0

CONFIG_SPI=y
CONFIG_SPI_NOR=y
CONFIG_SPI_GECKO=y
```

## samples/subsys/shell/shell_module/boards/efm32pg_stk3402a.conf
```kconfig
# Copyright (c) 2022 T-Mobile USA, Inc.
#
# SPDX-License-Identifier: Apache-2.0

CONFIG_SHELL=y
CONFIG_GPIO_SHELL=y
CONFIG_DEVICE_SHELL=y
CONFIG_I2C=y
CONFIG_REBOOT=y
CONFIG_LED=y
CONFIG_LED_PWM=y
CONFIG_LED_SHELL=y
CONFIG_PWM=y
CONFIG_PWM_SHELL=y
CONFIG_PWM_GECKO=y
```

## samples/synchronization/sample.yaml
```yaml
sample:
  description: A simple application that demonstrates
    basic sanity of the kernel.
  name: Synchronization Sample
tests:
  sample.kernel.synchronization:
    platform_exclude: efm32pg_stk3402a
    build_on_all: true
    tags: synchronization
    harness: console
    harness_config:
      type: multi_line
      regex:
        - "thread_a: Hello World from (.*)!"
        - "thread_b: Hello World from (.*)!"
```

## samples/userspace/prod_consumer/sample.yaml
```yaml
sample:
  description: userspace producer-consumer example
  name: producer-consumer
common:
  integration_platforms:
    - mps2_an385
  tags: userspace
  harness: console
  harness_config:
    type: one_line
    regex:
      - "SUCCESS"
tests:
  sample.userspace.prod_consumer:
    platform_exclude: efm32pg_stk3402a
    filter: CONFIG_ARCH_HAS_USERSPACE
```

## tests/application_development/gen_inc_file/testcase.yaml
```yaml
tests:
  buildsystem.include_file:
    platform_exclude: efm32pg_stk3402a
    integration_platforms:
      - native_posix
    tags: gen_inc_file
```

## tests/arch/arm/arm_irq_zero_latency_levels/testcase.yaml
```yaml
common:
  filter: (CONFIG_ARMV6_M_ARMV8_M_BASELINE or CONFIG_ARMV7_M_ARMV8_M_MAINLINE) and
    not CONFIG_SOC_FAMILY_NRF
  tags: arm interrupt
  arch_allow: arm
tests:
  arch.arm.irq_zero_latency_levels:
    platform_exclude: efm32pg_stk3402a
    filter: not CONFIG_TRUSTED_EXECUTION_NONSECURE
  arch.arm.irq_zero_latency_levels.secure_fw:
    filter: CONFIG_TRUSTED_EXECUTION_SECURE
```

## tests/arch/arm/arm_ramfunc/testcase.yaml
```yaml
tests:
  arch.arm.ramfunc:
    platform_exclude: efm32pg_stk3402a
    filter: CONFIG_ARCH_HAS_RAMFUNC_SUPPORT
    tags: arm userspace
    arch_allow: arm
    extra_configs:
      - CONFIG_PICOLIBC_HEAP_SIZE=0
```

## tests/arch/arm/arm_runtime_nmi/testcase.yaml
```yaml
tests:
  arch.interrupt.arm.nmi:
    platform_exclude: efm32pg_stk3402a
    filter: CONFIG_ARMV6_M_ARMV8_M_BASELINE or CONFIG_ARMV7_M_ARMV8_M_MAINLINE and
      not CONFIG_BUILD_WITH_TFM
    arch_allow: arm
    tags: nmi interrupt arm
```

## tests/arch/arm/arm_tz_wrap_func/testcase.yaml
```yaml
tests:
  arch.arm.tz_wrap_func:
    platform_exclude: efm32pg_stk3402a
    arch_allow: arm
    tags: arm tz_ns tz_wrap_func
    filter: CONFIG_CPU_CORTEX_M
```

## tests/arch/common/timing/testcase.yaml
```yaml
common:
  filter: CONFIG_ARCH_HAS_TIMING_FUNCTIONS
  platform_type:
    - mcu
    - native
tests:
  arch.common.timing:
    platform_exclude: efm32pg_stk3402a
    tags: timing arch
```

## tests/benchmarks/data_structure_perf/dlist_perf/testcase.yaml
```yaml
tests:
  benchmark.data_structure_perf.dlist:
    platform_exclude: efm32pg_stk3402a
    tags: benchmark dlist
```

## tests/benchmarks/data_structure_perf/rbtree_perf/testcase.yaml
```yaml
tests:
  benchmark.data_structure_perf.rbtree:
    platform_exclude: efm32pg_stk3402a
    tags: benchmark rbtree
```

## tests/benchmarks/sys_kernel/testcase.yaml
```yaml
tests:
  benchmark.kernel.core:
    platform_exclude: efm32pg_stk3402a
    arch_exclude: nios2 xtensa
    min_ram: 32
    tags: benchmark
    timeout: 120
```
